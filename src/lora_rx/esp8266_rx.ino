#include <ESP8266WiFi.h>
#include <SPI.h>
#include <LoRa.h>
#include <Wire.h>  
#include <Adafruit_GFX.h>
#include <Adafruit_SSD1306.h>

//define the pins used by the transceiver module
#define ss    3 
#define rst   16 // gpio16 // d0
#define dio0  15 // gpio15 // d8
#define oled_addr 0x3c
#define sync_word 0xf8
#define spread_factor 12

//433E6 for Asia
//866E6 for Europe
//915E6 for North America
#define freq      923E6

#define SCREEN_WIDTH 128 // OLED display width, in pixels
#define SCREEN_HEIGHT 64 // OLED display height, in pixels

static const uint8_t PROGMEM dickbutt_bits[] = {
   0x00, 0x00, 0x00, 0x00, 0x00, 0x00, 0xd0, 0x05, 0x00, 0x00, 0x00, 0x00,
   0x00, 0x00, 0x00, 0x00, 0x00, 0x00, 0x00, 0x00, 0x00, 0x00, 0xfc, 0x3f,
   0x00, 0x00, 0x00, 0x00, 0x00, 0x00, 0x00, 0x00, 0x00, 0x00, 0x00, 0x00,
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   0x00, 0x00, 0x00, 0x00 };

// Declaration for an SSD1306 display connected to I2C (SDA, SCL pins)
#define OLED_RESET     -1 // Reset pin # (or -1 if sharing Arduino reset pin)
Adafruit_SSD1306 display(SCREEN_WIDTH, SCREEN_HEIGHT, &Wire, OLED_RESET);

String row1LCD = "";
String row2LCD = "";
String rssi = "";
int counter = 0;

void setup() {

  // https://www.instructables.com/id/5-Quirks-of-Using-the-ESP8266/?fbclid=IwAR0MsRAcyEfZBElME0NCyNI_gUJcv2b9OyjSvpPiFQUH4rcUnrmjo5jOPfE
  WiFi.mode(WIFI_OFF);

  //initialize Serial Monitor
  Serial.begin(115200);

  if(!display.begin(SSD1306_SWITCHCAPVCC, oled_addr)) { // Address 0x3D for 128x64
    Serial.println(F("SSD1306 allocation failed"));
    for(;;); // Don't proceed, loop forever
  }
  
  display.clearDisplay();
  display.drawXBitmap(0, 0, dickbutt_bits, SCREEN_WIDTH-1, SCREEN_HEIGHT-1, WHITE);
  display.display();
  delay(3000); // Pause for 2 seconds

  // Clear the buffer
  display.clearDisplay();

  display.setTextColor(SSD1306_WHITE); // Draw white text
  display.cp437(true);         // Use full 256 char 'Code Page 437' font

  display.setCursor(0, 0);     // Start at top-left corner
  display.print("LoRa rx init ..");
  display.display();

  //setup LoRa transceiver module
  LoRa.setPins(ss, rst, dio0);
  
  while (!LoRa.begin(freq)) 
  {
    display.print("..");
    display.display();
    delay(500);
  }

  LoRa.setSyncWord(sync_word);
  LoRa.enableCrc();
  LoRa.setSpreadingFactor(spread_factor);
  display.println("");
  display.println("LoRa initialised!");
  display.print("Key: 0x");
  display.println(sync_word, HEX);
  display.print("Freq: ");
  display.println(freq);
  display.print("SF: ");
  display.println(spread_factor);
  
  display.display();
  delay(500);

  display.println("Waiting for packet ..");
  display.display();
}

void loop() 
{
  // try to parse packet
  int packetSize = LoRa.parsePacket();
  if (packetSize) 
  {
    // received a packet
    counter++;
    Serial.print("Received packet " + counter);

    while (LoRa.available()) {
      row2LCD = LoRa.readString();
      Serial.print(row2LCD); 
    }

    // print RSSI of packet
    rssi = LoRa.packetRssi();
    Serial.println("' with RSSI " + rssi + " and length " + row2LCD.length());

    display.clearDisplay();
    display.setCursor(0, 0);

    // print info
    display.setTextSize(1);
    row1LCD = "RSSI: " + rssi;
    display.println(row1LCD);
    display.print("Key: 0x");
    display.println(sync_word, HEX);
    display.print("SF: ");
    display.println(spread_factor);
    display.print("Count: ");
    display.println(counter);

    // print message
    display.println("");
    display.setTextSize(1.5);  
    display.println(row2LCD);
    display.display();
  }
}